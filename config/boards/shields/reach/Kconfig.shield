## reach_left_zmk/config/boards/shields/reach/Kconfig.defconfig
```kconfig
if SHIELD_REACH_LEFT
config ZMK_KEYBOARD_NAME
    default "Reach Left"
config ZMK_SPLIT
    default y
config ZMK_SPLIT_ROLE_CENTRAL
    default y
endif
```
